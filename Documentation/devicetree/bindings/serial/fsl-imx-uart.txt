## Documentation/devicetree/bindings/serial/fsl-imx-uart.txt
```
* Freescale i.MX Universal Asynchronous Receiver/Transmitter (UART)

Required properties:
- compatible : Should be "fsl,<soc>-uart"
- reg : Address and length of the register set for the device
- interrupts : Should contain uart interrupt

Optional properties:
- fsl,dte-mode : Indicate the uart works in DTE mode. The uart works
                  in DCE mode by default.
- rs485-rts-delay, rs485-rts-active-low, rs485-rx-during-tx,
  linux,rs485-enabled-at-boot-time: see rs485.txt. Note that for RS485
  you must enable either the "uart-has-rtscts" or the "rts-gpios"
  properties. In case you use "uart-has-rtscts" the signal that controls
  the transceiver is actually CTS_B, not RTS_B. CTS_B is always output,
  and RTS_B is input, regardless of dte-mode.
- fsl,rs485-de-gpio: Use GPIO to enable the rs485 transceiver. Use if your
                      board layout has rts/cts lines swapped

Please check Documentation/devicetree/bindings/serial/serial.txt
for the complete list of generic properties.

Note: Each uart controller should have an alias correctly numbered
in "aliases" node.

Example:

aliases {
	serial0 = &uart1;
};

uart1: serial@73fbc000 {
	compatible = "fsl,imx51-uart", "fsl,imx21-uart";
	reg = <0x73fbc000 0x4000>;
	interrupts = <31>;
	uart-has-rtscts;
	fsl,dte-mode;
    fsl,rs485-de-gpio = <&gpio5 8 GPIO_ACTIVE_HIGH>;
};
```
